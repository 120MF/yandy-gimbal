## west.yml
```yaml
manifest:
  remotes:
    - name: zephyrproject-rtos
      url-base: https://github.com/zephyrproject-rtos
    - name: robomaster-dlmu
      url-base: https://github.com/RoboMaster-DLMU-CONE
    - name: origin
      url-base: https://github.com/120MF

  projects:
    - name: zephyr
      remote: zephyrproject-rtos
      revision: main
      import:
        name-allowlist:
          - cmsis
          - cmsis_6
          - hal_stm32

    - name: one-framework
      remote: robomaster-dlmu
      revision: main
      path: modules/lib/one-framework
      import: true


    - name: yandy-gimbal
      url: https://github.com/120MF/yandy-gimbal
      path: modules/lib/nodes/yandy-gimbal
      revision: main

  self:
    path: yandy-gimbal
```

## zephyr/Kconfig
```kconfig
config YANDY_GIMBAL
    bool "yandy-gimbal node for OneFramework"
    select ONE_MOTOR
    select NOTIFY_HUB
    select VT_HUB
    depends on ONE_FRAMEWORK
    help
      Enable yandy-gimbal node.

if YANDY_GIMBAL

module = YANDY_GIMBAL
module-str = YANDY_GIMBAL
source "subsys/logging/Kconfig.template.log_config"

endif # YANDY_GIMBAL
```
